## sdkconfig.defaults
```kconfig
# WLtoys 6401 prototype firmware — default sdkconfig
#
# Target: ESP32-S3.
# Console/logging goes over USB-Serial-JTAG so the diagnostics UART (see
# PROTOCOL_ANALYSIS.md / IMPLEMENTATION_PLAN.md §10) never touches GPIO4,
# which is dedicated to the car's yellow signal wire via UART1.

CONFIG_IDF_TARGET="esp32s3"

CONFIG_ESP_CONSOLE_USB_SERIAL_JTAG=y
CONFIG_ESP_CONSOLE_SECONDARY_NONE=y

# Boot log noise reduction, keep only info-and-above by default.
CONFIG_LOG_DEFAULT_LEVEL_INFO=y

# 1000 Hz tick (1 ms resolution) so the 50 ms control loop, the startup
# neutral window, and the WebSocket failsafe timeout all convert to exact
# tick counts (pdMS_TO_TICKS never truncates to 0).
CONFIG_FREERTOS_HZ=1000

# --- Board: XIAO ESP32-S3 Sense (ESP32-S3R8) ------------------------------
# 8 MB flash.
CONFIG_ESPTOOLPY_FLASHSIZE_8MB=y

# Octal PSRAM, required to hold the camera framebuffers (esp32-camera uses
# CAMERA_FB_IN_PSRAM).
CONFIG_SPIRAM=y
CONFIG_SPIRAM_MODE_OCT=y
CONFIG_SPIRAM_SPEED_80M=y

# Custom partition table: the default caps the app at ~1 MB, too small for the
# wifi + http + camera build. partitions.csv gives the factory app 3 MB.
CONFIG_PARTITION_TABLE_CUSTOM=y
CONFIG_PARTITION_TABLE_CUSTOM_FILENAME="partitions.csv"

# WebSocket support in esp_http_server (GET /control is .is_websocket=true).
CONFIG_HTTPD_WS_SUPPORT=y
```
